# file: basic.ioc
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Mcu.Family=STM32F1
Mcu.Name=STM32F103C(8-B)Tx
Mcu.Package=LQFP48
NVIC.PriorityGroup=NVIC_PRIORITYGROUP_4
PA13.Mode=Serial_Wire
PA13.Signal=SYS_JTMS-SWDIO
PA14.Mode=Serial_Wire
PA14.Signal=SYS_JTCK-SWCLK
ProjectManager.HeapSize=0x200
ProjectManager.StackSize=0x400
ProjectManager.TargetToolchain=MDK-ARM V5
RCC.APB1Freq_Value=8000000
RCC.APB2Freq_Value=8000000
board=custom

// file: Core/Src/main.c
/* USER CODE BEGIN Header */
/**
  ******************************************************************************
  * @file           : main.c
  * @brief          : Main program body
  ******************************************************************************
  * @attention
  *
  * Copyright (c) 2024 STMicroelectronics.
  * All rights reserved.
  *
  * This software is licensed under terms that can be found in the LICENSE file
  * in the root directory of this software component.
  * If no LICENSE file comes with this software, it is provided AS-IS.
  *
  ******************************************************************************
  */
/* USER CODE END Header */

#include "main.h"
//#include "flash.h"
#include "flash2.h"

/* USER CODE BEGIN PD */
//#define FLASH_ADDR_PAGE_126 ((uint32_t)0x0801F810)
//#define FLASH_ADDR_PAGE_127 ((uint32_t)0x0801FC00)
//#define FLASH_USER_START_ADDR FLASH_ADDR_PAGE_126
//#define FLASH_USER_END_ADDR 	FLASH_ADDR_PAGE_127 + FLASH_PAGE_SIZE

/* USER CODE END PD */

/* USER CODE BEGIN PV */
//uint32_t startPage = FLASH_USER_START_ADDR;
//uint32_t endPage   = FLASH_USER_END_ADDR;
//uint32_t dataRead;
//char data[50] = {0};
/* USER CODE END PV */

void SystemClock_Config(void);
static void MX_GPIO_Init(void);

/* USER CODE BEGIN 0 */
char *data = 		":020000040800F2"
								":1020000070060020892100080B2B0008912A000887"
								":10201000092B00088B220008672B00080000000035"
								":1020000070060020892100080B2B0008912A000887"
								":10201000092B00088B220008672B00080000000035"
								":1020000070060020892100080B2B0008912A000887"
								":10201000092B00088B220008672B00080000000035"
								":1020000070060020892100080B2B0008912A000887"
								":10201000092B00088B220008672B00080000000035"
								":1020000070060020892100080B2B0008912A000887"
								":10201000092B00088B220008672B00080000000035";
uint32_t data2[] = {0xFFFFFFFF,0x12345678,0x23456789,0x34567890,0x45678901,0x56789012,0x67890123,0x78901234,0x89012345};
uint32_t Rx_Data[30];
char string[100];
int number = 123;
float val = 123.456;
float RxVal;

void FLASH_WritePage(uint32_t startPage, uint32_t endPage, uint32_t data32){
	HAL_FLASH_Unlock();
	FLASH_EraseInitTypeDef EraseInit;
	EraseInit.TypeErase = FLASH_TYPEERASE_PAGES;
	EraseInit.PageAddress = startPage;
	EraseInit.NbPages = 1;
	uint32_t PageError = 0;
	HAL_FLASHEx_Erase(&EraseInit, &PageError);
	HAL_FLASH_Program(FLASH_TYPEPROGRAM_WORD,startPage,data32);
	//HAL_FLASH_Program(FLASH_TYPEPROGRAM_WORD,startPage+4,0x09876543);
	HAL_FLASH_Lock();
}
uint32_t FLASH_ReadPage(uint32_t addr){
	uint32_t data = *(__IO uint32_t *)(addr);
	return data;
}
/* USER CODE END 0 */

int main(void)
{

  /* MCU Configuration--------------------------------------------------------*/

  /* Reset of all peripherals, Initializes the Flash interface and the Systick. */
  HAL_Init();

  /* Configure the system clock */
  SystemClock_Config();

  /* Initialize all configured peripherals */
  MX_GPIO_Init();
  /* USER CODE BEGIN 2 */
//	Flash_ProgramPage("Second data written to flash",FLASH_ADDR_PAGE_126,FLASH_ADDR_PAGE_127);
//	Flash_ReadChar(data,FLASH_ADDR_PAGE_126,FLASH_ADDR_PAGE_127);
//	HAL_Delay(2000);
//	Flash_ProgramPage("Old data",FLASH_ADDR_PAGE_126,FLASH_ADDR_PAGE_127);
//	Flash_ReadChar(data,FLASH_ADDR_PAGE_126,FLASH_ADDR_PAGE_127);
//	HAL_Delay(2000);
//	Flash_ProgramPage("o xe ke",DATA_START_ADDRESS,LENGTH_START_ADDRESS);
//	Flash_ReadChar(data,DATA_START_ADDRESS,LENGTH_START_ADDRESS);
//	HAL_Delay(2000);
//	FLASH_WritePage(FLASH_USER_START_ADDR, FLASH_USER_END_ADDR, 12345678);
//	HAL_Delay(2000);
//	FLASH_WritePage(FLASH_USER_START_ADDR, FLASH_USER_END_ADDR, 13245768);
	//dataRead = FLASH_ReadPage(FLASH_USER_START_ADDR);

//	Flash_Write_Data(0x08004410 , (uint32_t *)data2, 9);
//  Flash_Read_Data(0x08004410 , Rx_Data, 10);

  int numofwords = (strlen(data)/4)+((strlen(data)%4)!=0);
  Flash_Write_Data(0x08004810 , (uint32_t *)data, numofwords);
  Flash_Read_Data(0x08004810 , Rx_Data, numofwords);
  Convert_To_Str(Rx_Data, string);

//  Flash_Write_NUM(0x08005C10, number);
//  RxVal = Flash_Read_NUM(0x08005C10);

//  Flash_Write_NUM(0x08012000, val);
//  RxVal = Flash_Read_NUM(0x08012000);
  /* USER CODE END 2 */

  /* Infinite loop */
  while (1)
  {
		Flash_Read_Data(0x08004810 , Rx_Data, numofwords);
  }
}

void SystemClock_Config(void)
{
  RCC_OscInitTypeDef RCC_OscInitStruct = {0};
  RCC_ClkInitTypeDef RCC_ClkInitStruct = {0};

  /** Initializes the RCC Oscillators according to the specified parameters
  * in the RCC_OscInitTypeDef structure.
  */
  RCC_OscInitStruct.OscillatorType = RCC_OSCILLATORTYPE_HSI;
  RCC_OscInitStruct.HSIState = RCC_HSI_ON;
  RCC_OscInitStruct.HSICalibrationValue = RCC_HSICALIBRATION_DEFAULT;
  RCC_OscInitStruct.PLL.PLLState = RCC_PLL_NONE;
  if (HAL_RCC_OscConfig(&RCC_OscInitStruct) != HAL_OK)
  {
    Error_Handler();
  }

  /** Initializes the CPU, AHB and APB buses clocks
  */
  RCC_ClkInitStruct.ClockType = RCC_CLOCKTYPE_HCLK|RCC_CLOCKTYPE_SYSCLK
                              |RCC_CLOCKTYPE_PCLK1|RCC_CLOCKTYPE_PCLK2;
  RCC_ClkInitStruct.SYSCLKSource = RCC_SYSCLKSOURCE_HSI;
  RCC_ClkInitStruct.AHBCLKDivider = RCC_SYSCLK_DIV1;
  RCC_ClkInitStruct.APB1CLKDivider = RCC_HCLK_DIV1;
  RCC_ClkInitStruct.APB2CLKDivider = RCC_HCLK_DIV1;

  if (HAL_RCC_ClockConfig(&RCC_ClkInitStruct, FLASH_LATENCY_0) != HAL_OK)
  {
    Error_Handler();
  }
}

static void MX_GPIO_Init(void)
{

  /* GPIO Ports Clock Enable */
  __HAL_RCC_GPIOA_CLK_ENABLE();

}

void Error_Handler(void)
{
  __disable_irq();
  while (1)
  {
  }
}
